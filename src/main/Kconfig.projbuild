## src/main/Kconfig.projbuild
```kconfig
menu "Gapper Central configuration"

    config ROUTER_WAIT
        int "Milliseconds to wait after powering up the router"
        default 30000

    config MAX_CONNECT_WAIT
        int "Maximum Milliseconds to wait for connection to AP"
        default 30000

    config MAX_SEND_WAIT
        int "Maximum Milliseconds to wait for sending data files"
        default 20000

    config MAX_SNTP_WAIT
        int "Maximum Milliseconds to wait for time synchronization"
        default 10000

    menu "Wifi Configuration"

        config WIFI_SSID
            string "Wifi SSID"

        config WIFI_PASSWORD
            string "Wifi password"
        
        config WIFI_LISTEN_INTERVAL
            int "WiFi listen interval"
            default 3
            help
                Interval for station to listen to beacon from AP. The unit of listen interval is one beacon interval.
                For example, if beacon interval is 100 ms and listen interval is 3, the interval for station to listen
                to beacon is 300 ms.
    endmenu 

    menu "Power Saving"

        choice POWER_SAVE_MODE
            prompt "power save mode"
            default POWER_SAVE_MIN_MODEM
            help
                Power save mode for the esp32 to use. Modem sleep mode includes minimum and maximum power save modes.
                In minimum power save mode, station wakes up every DTIM to receive beacon. Broadcast data will not be
                lost because it is transmitted after DTIM. However, it can not save much more power if DTIM is short
                for DTIM is determined by AP.
                In maximum power save mode, station wakes up every listen interval to receive beacon. Broadcast data
                may be lost because station may be in sleep state at DTIM time. If listen interval is longer, more power
                is saved but broadcast data is more easy to lose.

            config POWER_SAVE_NONE
                bool "none"
            config POWER_SAVE_MIN_MODEM
                bool "minimum modem"
            config POWER_SAVE_MAX_MODEM
                bool "maximum modem"
        endchoice

        choice DYNAMIC_MAX_CPU_FREQ
            prompt "Maximum CPU frequency"
            default DYNAMIC_MAX_CPU_FREQ_80
            help
                Maximum CPU frequency to use for dynamic frequency scaling.

            config DYNAMIC_MAX_CPU_FREQ_80
                bool "80 MHz"
            config DYNAMIC_MAX_CPU_FREQ_160
                bool "160 MHz"
            config DYNAMIC_MAX_CPU_FREQ_240
                bool "240 MHz"
        endchoice

        config DYNAMIC_MAX_CPU_FREQ_MHZ
            int
            default 80 if DYNAMIC_MAX_CPU_FREQ_80
            default 160 if DYNAMIC_MAX_CPU_FREQ_160
            default 240 if DYNAMIC_MAX_CPU_FREQ_240


        choice DYNAMIC_MIN_CPU_FREQ
            prompt "Minimum CPU frequency"
            default DYNAMIC_MIN_CPU_FREQ_10M
            help
                Minimum CPU frequency to use for dynamic frequency scaling.
                Should be set to XTAL frequency or XTAL frequency divided by integer.

            config DYNAMIC_MIN_CPU_FREQ_40M
                bool "40 MHz (use with 40MHz XTAL)"
                depends on ESP32_XTAL_FREQ_40 || ESP32_XTAL_FREQ_AUTO
            config DYNAMIC_MIN_CPU_FREQ_20M
                bool "20 MHz (use with 40MHz XTAL)"
                depends on ESP32_XTAL_FREQ_40 || ESP32_XTAL_FREQ_AUTO
            config DYNAMIC_MIN_CPU_FREQ_10M
                bool "10 MHz (use with 40MHz XTAL)"
                depends on ESP32_XTAL_FREQ_40 || ESP32_XTAL_FREQ_AUTO
            config DYNAMIC_MIN_CPU_FREQ_26M
                bool "26 MHz (use with 26MHz XTAL)"
                depends on ESP32_XTAL_FREQ_26 || ESP32_XTAL_FREQ_AUTO
            config DYNAMIC_MIN_CPU_FREQ_13M
                bool "13 MHz (use with 26MHz XTAL)"
                depends on ESP32_XTAL_FREQ_26 || ESP32_XTAL_FREQ_AUTO
        endchoice

        config DYNAMIC_MIN_CPU_FREQ_MHZ
            int
            default 40 if DYNAMIC_MIN_CPU_FREQ_40M
            default 20 if DYNAMIC_MIN_CPU_FREQ_20M
            default 10 if DYNAMIC_MIN_CPU_FREQ_10M
            default 26 if DYNAMIC_MIN_CPU_FREQ_26M
            default 13 if DYNAMIC_MIN_CPU_FREQ_13M
            
    endmenu

    choice SNTP_TIME_SYNC_METHOD
        prompt "Time synchronization method"
        default SNTP_TIME_SYNC_METHOD_IMMED
        help
            Time synchronization method.

        config SNTP_TIME_SYNC_METHOD_IMMED
            bool "update time immediately when received"
        config SNTP_TIME_SYNC_METHOD_SMOOTH
            bool "update time with smooth method (adjtime)"
        config SNTP_TIME_SYNC_METHOD_CUSTOM
            bool "custom implementation"
    endchoice
	
endmenu
```

## src/sdkconfig.defaults
```kconfig
#
# Compiler options DEBUG
#
CONFIG_OPTIMIZATION_LEVEL_DEBUG=y
CONFIG_OPTIMIZATION_ASSERTIONS_ENABLED=y
CONFIG_STACK_CHECK_ALL=y
CONFIG_STACK_CHECK=y
CONFIG_WARN_WRITE_STRINGS=y
CONFIG_LOG_DEFAULT_LEVEL_DEBUG=y

#
# Serial flasher config
#
CONFIG_ESPTOOLPY_FLASHSIZE_4MB=y
CONFIG_ESPTOOLPY_BAUD_230400B=y

#
# Partition Table
#
CONFIG_PARTITION_TABLE_CUSTOM=y
CONFIG_PARTITION_TABLE_CUSTOM_FILENAME="partitions.csv"

#
# ESP32-specific
#
CONFIG_IDF_TARGET_ESP32=y
CONFIG_ESP32_DEFAULT_CPU_FREQ_80=y
CONFIG_SPIRAM_SUPPORT=y
CONFIG_SPIRAM_IGNORE_NOTFOUND=y
CONFIG_WIFI_LWIP_ALLOCATION_FROM_SPIRAM_FIRST=y
CONFIG_SPIRAM_TYPE_ESPPSRAM64=y

CONFIG_PM_ENABLE=y
CONFIG_FREERTOS_USE_TICKLESS_IDLE=y
```
